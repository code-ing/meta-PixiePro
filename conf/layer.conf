## conf/layer.conf
```bitbake
# We have a conf and classes directory, add to BBPATH
BBPATH .= ":${LAYERDIR}"

# We have recipes-* directories, add to BBFILES
BBFILES += "${LAYERDIR}/recipes-*/*/*.bb \
	${LAYERDIR}/recipes-*/*/*.bbappend"

BBFILE_COLLECTIONS += "PixiePro"
BBFILE_PATTERN_PixiePro = "^${LAYERDIR}/"
BBFILE_PRIORITY_PixiePro = "6"
```

## conf/machine/pixiepro.conf
```bitbake
#@TYPE: Machine
#@NAME: CODE PixiePro
#@SOC: i.MX6Q
#@DESCRIPTION: Machine configuration for CODE PixiePro
#@MAINTAINER: Valentina Fernandez Alanis valentina.fernandez@code-ing.com

include conf/machine/include/imx-base.inc
include conf/machine/include/tune-cortexa9.inc

SOC_FAMILY = "mx6:mx6q"
KERNEL_DEVICETREE ?= "imx6q-pixiepro.dtb"
KERNEL_IMAGETYPE = "zImage"

# UBOOT_MACHINE ?= "pixiepro_config"

PREFERRED_PROVIDER_virtual/kernel ?= "linux-pixiepro"

SERIAL_CONSOLE = "115200 ttymxc1"
```
